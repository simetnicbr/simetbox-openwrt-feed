## simetbox-openwrt-availability-config/Config.in
```kconfig
# SIMETBox configuration
menu "Configuration"
	depends on PACKAGE_simetbox-openwrt-availability-config

	config SIMETBOX_TR069
		string "TR-069 server address"
		help
			TR-069 server address
		default "https://acs.simet.nic.br/tr069"
endmenu
```

## simetbox-openwrt-base/Config.in
```kconfig
# SIMETBox configuration
menu "Configuration"
	depends on PACKAGE_simetbox-openwrt-base

	config SIMETBOX_COMMON
		bool "SIMET1: Standard measurements (legacy)"
		help
			Common files and structure to measure thoughput, latency, jitter and packet loss.
		default n

	config SIMETBOX_PORT25
		bool "SIMET1: Port 25 management"
		help
			Structure to test the output to port 25
		depends on SIMETBOX_COMMON
		default y

	config SIMETBOX_CONTENT_PROVIDER
		bool "SIMET1: Content Providers"
		help
			Structure to find the location of content providers
		depends on SIMETBOX_COMMON
		default y
	
	config SIMETBOX_DNS
		bool "SIMET1: DNS measurements and ping to gateway"
		help
			Structure to measure the quality for connections to DNS root servers and latency to the network gateway
		depends on SIMETBOX_COMMON
		default y
	
	config SIMETBOX_TOP10
		bool "SIMET1: Alexa top 10 Brazil"
		help
			Structure to measure the quality for the Alexa top 10 Brazil
		depends on SIMETBOX_COMMON
		default y
	
	config SIMETBOX_TRAFFIC
		bool "SIMET1: Traffic amount registration"
		help
			Structure to calculate the amount of traffic used by the equipment
		depends on SIMETBOX_COMMON
		default y
	
	config SIMETBOX_BCP38
		bool "SIMET1: BCP 38 validation"
		help
			Structure to calculate the amount of traffic used by the equipment
		depends on SIMETBOX_COMMON
		default y
endmenu
```

## simetbox-openwrt-simet-ma/Config.in
```kconfig
# SIMETBox configuration
menu "Configuration"
	depends on PACKAGE_simetbox-openwrt-simet-ma

	config SIMET2_SPOOFER
		bool "SIMET2: anti-spoofing validation (broken)"
		help
			Attempts to measure whether anti-origin-spoofing defenses are deployed.
			Note: this measurement sends packets with spoofed origin address to NIC.br
			servers.  Warning: currently does not bypass on-device NAT, and it has
			other issues, please enable only for debugging or development purposes.
		default n

	config SIMETBOX_APPLINK
		bool "SIMETBox: mobile app access"
		help
			Enables functionality related to configuration and joint-testing
			through mobile apps.
			Warning: do not enable on OpenWRT 15 (Chaos Calmer), rpcd will crash.
		default n
endmenu
```
